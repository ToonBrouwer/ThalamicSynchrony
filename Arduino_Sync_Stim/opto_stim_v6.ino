// =============================================================================
// TRN Optogenetic Stimulation Paradigm — Arduino Due  v6
// =============================================================================
// Stimuli (11 types, 20 reps each = 220 trials, ~55 min):
//   ChirpFwd   — log sweep 0.5->200 Hz, 5s, 0->DAC_TARGET
//   ChirpRev   — same sweep reversed
//   NoiseLp100 — lowpass white noise 0-100 Hz, starts with ramp
//   NoiseLp500 — lowpass white noise 0-500 Hz, starts with ramp
//   Sine2Hz    — 2 Hz sinusoid
//   Sine10Hz   — 10 Hz sinusoid
//   Sine25Hz   — 25 Hz sinusoid
//   Sine60Hz   — 60 Hz sinusoid
//   Sine100Hz  — 100 Hz sinusoid
//   Sine500Hz  — 500 Hz sinusoid
//   Ramp       — 250ms rise to DAC_TARGET, then plateau
//
// Noise tables are pre-computed in Python (inspect_stimuli_v3.ipynb) and
// stored in Arduino flash (PROGMEM) via noise_tables.h — exact same samples
// you inspect in the notebook.
//
// Trial order is pre-generated in Python and stored as a PROGMEM array.
// Same sequence every run — load noise_tables.h and trial_sequence.h from
// the output of the notebook before uploading.
//
// WIRING:
//   DAC0  -> BNC centre -> Doric LED driver BNC input
//   GND   -> BNC shield -> Doric driver GND
//   Pin 2 -> TTL sync output (optional)
// =============================================================================

#include <avr/pgmspace.h>
#include "noise_tables.h"      // generated by notebook — LP100 and LP500 tables
#include "trial_sequence.h"    // generated by notebook — TRIAL_SEQUENCE array

// ── USER PARAMETERS ──────────────────────────────────────────────────────────
#define USE_TTL          true
#define TTL_PIN          2
#define DAC_PIN          DAC0

const float  STIM_DURATION  = 5.0f;     // seconds, all stimuli equal
const int    SAMPLE_RATE    = 10000;    // Hz
const float  RAMP_RISE_MS   = 250.0f;  // ms rise for ramp + noise stimuli
const int    DAC_TARGET     = 2047;    // 50% = 1.65V — plateau and noise centre
const int    NOISE_AMP      = 1800;    // ± DAC counts (in noise_tables.h)
const float  ISI_BASE_SEC   = 10.0f;
const float  ISI_JITTER_PCT = 20.0f;

// =============================================================================
// ── INTERNALS ────────────────────────────────────────────────────────────────
// =============================================================================

const int TOTAL_SAMPLES  = (int)(STIM_DURATION * SAMPLE_RATE); // 50000
const int NOISE_TBL_LEN  = 10000;   // 1s table, looped
const int RAMP_RISE_SAMP = (int)(RAMP_RISE_MS / 1000.0f * SAMPLE_RATE); // 2500

// Stimulus type enum — order must match TRIAL_SEQUENCE codes in trial_sequence.h
enum StimulusType {
  CHIRP_FWD = 0,
  CHIRP_REV,
  NOISE_LP100,
  NOISE_LP500,
  SINE_2HZ,
  SINE_10HZ,
  SINE_25HZ,
  SINE_60HZ,
  SINE_100HZ,
  SINE_500HZ,
  RAMP,
  NUM_STIM_TYPES
};

// Human-readable names for serial log
const char* STIM_NAMES[] = {
  "ChirpFwd", "ChirpRev",
  "NoiseLp100", "NoiseLp500",
  "Sine2", "Sine10", "Sine25", "Sine60", "Sine100", "Sine500",
  "Ramp"
};

// Sinusoid frequencies matching enum order
const float SINE_FREQS[] = { 2.0f, 10.0f, 25.0f, 60.0f, 100.0f, 500.0f };

// ── SETUP ─────────────────────────────────────────────────────────────────────

void setup() {
  Serial.begin(115200);

  #if USE_TTL
    pinMode(TTL_PIN, OUTPUT);
    digitalWrite(TTL_PIN, LOW);
  #endif

  analogWrite(DAC_PIN, 0);

  // Print full pre-generated trial sequence so it can be logged
  Serial.print("TRIALS:");
  Serial.println(TOTAL_TRIALS);
  Serial.print("ORDER:");
  for (int i = 0; i < TOTAL_TRIALS; i++) {
    Serial.print(pgm_read_byte(&TRIAL_SEQUENCE[i]));
    if (i < TOTAL_TRIALS - 1) Serial.print(",");
  }
  Serial.println();

  delay(3000);
}

// ── MAIN LOOP ─────────────────────────────────────────────────────────────────

void loop() {
  for (int t = 0; t < TOTAL_TRIALS; t++) {

    // Jittered ISI
    float isi = ISI_BASE_SEC * (1.0f
                + (random(-100, 101) / 100.0f) * (ISI_JITTER_PCT / 100.0f));
    delay((unsigned long)(isi * 1000.0f));

    // Log: trial_num, stim_code
    StimulusType stim = (StimulusType)pgm_read_byte(&TRIAL_SEQUENCE[t]);
    Serial.print(t + 1);
    Serial.print(",");
    Serial.println(STIM_NAMES[stim]);

    #if USE_TTL
      digitalWrite(TTL_PIN, HIGH);
    #endif

    runStimulus(stim);

    analogWrite(DAC_PIN, 0);

    #if USE_TTL
      digitalWrite(TTL_PIN, LOW);
    #endif
  }

  Serial.println("DONE");
  while (true) delay(1000);
}

// =============================================================================
// ── STIMULUS DISPATCHER ───────────────────────────────────────────────────────
// =============================================================================

void runStimulus(StimulusType stim) {
  switch (stim) {
    case CHIRP_FWD:   playChirpFwd();             break;
    case CHIRP_REV:   playChirpRev();             break;
    case NOISE_LP100: playNoise(NOISE_LP100_TBL); break;
    case NOISE_LP500: playNoise(NOISE_LP500_TBL); break;
    case SINE_2HZ:    playSine(SINE_FREQS[0]);    break;
    case SINE_10HZ:   playSine(SINE_FREQS[1]);    break;
    case SINE_25HZ:   playSine(SINE_FREQS[2]);    break;
    case SINE_60HZ:   playSine(SINE_FREQS[3]);    break;
    case SINE_100HZ:  playSine(SINE_FREQS[4]);    break;
    case SINE_500HZ:  playSine(SINE_FREQS[5]);    break;
    case RAMP:        playRamp();                  break;
    default: break;
  }
}

// =============================================================================
// ── WAVEFORM PLAYERS ──────────────────────────────────────────────────────────
// =============================================================================

// Chirp: computed at float32 on-the-fly — no table, no quantisation artefacts.
// The Due's ARM Cortex-M3 has hardware FPU so powf/sinf run efficiently.
void playChirpFwd() {
  float k    = powf(200.0f / 0.5f, 1.0f / STIM_DURATION);
  float logK = logf(k);
  for (int i = 0; i < TOTAL_SAMPLES; i++) {
    float ts    = (float)i / SAMPLE_RATE;
    float phase = 2.0f * PI * 0.5f * (powf(k, ts) - 1.0f) / logK;
    analogWrite(DAC_PIN, (int)((0.5f + 0.5f * sinf(phase)) * DAC_TARGET));
    delayMicroseconds(100);
  }
}

void playChirpRev() {
  float k    = powf(200.0f / 0.5f, 1.0f / STIM_DURATION);
  float logK = logf(k);
  for (int i = 0; i < TOTAL_SAMPLES; i++) {
    int   j     = TOTAL_SAMPLES - 1 - i;
    float ts    = (float)j / SAMPLE_RATE;
    float phase = 2.0f * PI * 0.5f * (powf(k, ts) - 1.0f) / logK;
    analogWrite(DAC_PIN, (int)((0.5f + 0.5f * sinf(phase)) * DAC_TARGET));
    delayMicroseconds(100);
  }
}

// Ramp: 250ms linear rise to DAC_TARGET, then plateau for remainder
void playRamp() {
  for (int i = 0; i < RAMP_RISE_SAMP; i++) {
    analogWrite(DAC_PIN, (int)((float)i / (RAMP_RISE_SAMP - 1) * DAC_TARGET));
    delayMicroseconds(100);
  }
  analogWrite(DAC_PIN, DAC_TARGET);
  for (int i = RAMP_RISE_SAMP; i < TOTAL_SAMPLES; i++) delayMicroseconds(100);
}

// Noise: ramp rise then band-limited noise from PROGMEM table
// The ramp at the start is the same 250ms as the Ramp stimulus — so noise
// stimuli are directly comparable to the ramp in terms of onset dynamics.
void playNoise(const int16_t* tbl) {
  // Ramp phase — same as playRamp()
  for (int i = 0; i < RAMP_RISE_SAMP; i++) {
    analogWrite(DAC_PIN, (int)((float)i / (RAMP_RISE_SAMP - 1) * DAC_TARGET));
    delayMicroseconds(100);
  }
  // Noise phase — remainder of stimulus
  int noise_samples = TOTAL_SAMPLES - RAMP_RISE_SAMP;
  for (int i = 0; i < noise_samples; i++) {
    int16_t val = (int16_t)pgm_read_word(tbl + (i % NOISE_TBL_LEN));
    analogWrite(DAC_PIN, constrain(DAC_TARGET + (int)val, 0, 4095));
    delayMicroseconds(100);
  }
}

// Sinusoid: 0 to DAC_TARGET at given frequency
void playSine(float freq) {
  float ph  = 0.0f;
  float inc = 2.0f * PI * freq / (float)SAMPLE_RATE;
  for (int i = 0; i < TOTAL_SAMPLES; i++) {
    analogWrite(DAC_PIN, (int)((0.5f + 0.5f * sinf(ph)) * DAC_TARGET));
    ph += inc;
    if (ph >= 2.0f * PI) ph -= 2.0f * PI;
    delayMicroseconds(100);
  }
}
